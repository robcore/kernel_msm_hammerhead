## Documentation/devicetree/bindings/arm/msm/msm_thermal.txt
```
MSM thermal driver (MSM_THERMAL)

MSM_THERMAL is a kernel platform driver which limits CPU frequency during
thermal conditions to prevent overheating and physical damage. This driver
uses thermal sensors (tsens) to check the current temperature and limit
CPU frequency when it reaches one of the limits. Current thermal driver
presentation has 3 thermal limits: low, mid and max. This can improve
overall performance and stability of the system when the temp is high.
When the temp raises up to the preset threshold, CPU max frequency will
be set to "allowed_<limit>_freq".
After the temp raises down to the preset threshold, CPU max frequency will
be reset back to previous limit, or, if not, raise back to the max_freq.

The devicetree representation of the MSM_THERMAL block should be placed
in board file:

Required properties:

- msm_therma_data name: "msm_thermal_pdata"
- sensor_id: The id of the TSENS sensor polled for temperature.
		Typically the sensor closest to CPU0.
- poll_ms: Sampling interval to read sensor, in ms.
- shutdown_temp: Threshold temperature to turn down the system.
- allowed_max_high: Thershold temperature to ramp down CPU max frequency
		to a limit, stated in "allowed_max_freq"
- allowed_max_low: Thershold temperature to ramp up CPU max frequency
		to a limit, stated in "allowed_mid_freq"
- allowed_max_freq: Frequency, which wiil be used after the temp goes up
		"allowed_max_high"
- allowed_mid_high: Thershold temperature to ramp down CPU max frequency
		to a limit, stated in "allowed_mid_freq"
- allowed_mid_low: Thershold temperature to ramp up CPU max frequency
		to a limit, stated in "allowed_low_freq"
- allowed_mid_freq: Frequency, which will be used after the temp goes up
		"allowed_mid_high"
- allowed_low_high: Thershold temperature to ramp down CPU max frequency
		to a limit, stated in "allowed_low_freq"
- allowed_low_low: Thershold temperature to ramp up CPU frequency
		to a saved limit, or, to the max_freq
- allowed_low_freq: Frequency, which be used after the temp goes up
		"allowed_low_high"

Example:

static struct msm_thermal_data msm_thermal_pdata = {
	.sensor_id = 0,
	.poll_ms = 400,
	.shutdown_temp = 90,

	.allowed_max_high = 88,
	.allowed_max_low = 85,
	.allowed_max_freq = 729600,

	.allowed_mid_high = 85,
	.allowed_mid_low = 82,
	.allowed_mid_freq = 1190400,

	.allowed_low_high = 82,
	.allowed_low_low = 79,
	.allowed_low_freq = 1728000,
};
```
